## conf/distro/include/audit.inc
```bitbake
#
# DISTRO Feature: audit
# Comprehensive logging and audit framework for production security monitoring
#
# This feature provides:
# - System call auditing (audit package)
# - Advanced system logging (rsyslog)
# - Automated log rotation (logrotate)
# - System performance analysis (systemd-analyze)
#
# Usage: Add "audit" to DISTRO_FEATURES for boards requiring comprehensive logging
#

# Add audit and logging packages when audit feature is enabled
CORE_IMAGE_BASE_INSTALL:append = "${@bb.utils.contains('DISTRO_FEATURES', 'audit', ' audit logrotate rsyslog systemd-analyze', '', d)}"

# Auto-enable critical audit and logging services
SYSTEMD_AUTO_ENABLE:pn-audit = "${@bb.utils.contains('DISTRO_FEATURES', 'audit', 'enable', 'disable', d)}"
SYSTEMD_AUTO_ENABLE:pn-rsyslog = "${@bb.utils.contains('DISTRO_FEATURES', 'audit', 'enable', 'disable', d)}"

# Audit feature dependencies - ensure kernel audit support is enabled
DISTRO_FEATURES_BACKFILL_CONSIDERED:append = "${@bb.utils.contains('DISTRO_FEATURES', 'audit', ' audit-kernel', '', d)}"
```

## conf/distro/include/lmp-useradd-pipewire.inc
```bitbake
# LE Audio / PipeWire: meta-oe pipewire recipe creates system user "pipewire" (useradd-staticids).
# LmP sets USERADD_ERROR_DYNAMIC = "error" — add tables so the recipe is not skipped.
# Paths are resolved on BBPATH (see meta-dynamicdevices-distro/conf/layer.conf).
USERADD_UID_TABLES:append = " files/lmp-passwd-table-pipewire"
USERADD_GID_TABLES:append = " files/lmp-group-table-pipewire"
```

## conf/distro/lmp-dynamicdevices-base.conf
```bitbake
#
# Custom distribution based on the standard LMP distribution
# This allows us to extend with extra DISTRO features we need
# which can't be added elsewhere
#

require conf/distro/lmp-base.conf

DISTRO = "lmp-dynamicdevices-base"
DISTROOVERRIDES = "lmp:lmp-base:lmp-dynamicdevices-base"
DISTRO_NAME = "Linux-microPlatform Dynamic Devices (No Factory)"
##DISTRO_FEATURES_BACKFILL_CONSIDERED = "ldconfig"

## Don't allow zeroconf (avahi is viewed as a security risk)
DISTRO_FEATURES:remove = " zeroconf"

## PulseAudio support in host for sentai unit
DISTRO_FEATURES:append:imx8mm-jaguar-sentai = " pulseaudio"

## Improv protocol (BLE/Serial) onboarding for sentai unit
DISTRO_FEATURES:append:imx8mm-jaguar-sentai = " improv"

## Disable USB for inst board
DISTRO_FEATURES:remove:imx8mm-jaguar-inst = " usbhost usbgadget"

# Support commercial license as we need it for Sentai audio testing with sox which needs ffmpeg
LICENSE_FLAGS_ACCEPTED:append = " commercial"

# Enable reproducible builds by setting a fixed timestamp
# This ensures identical builds from identical source code
# Set to 2021-01-01 00:00:00 UTC (1609459200)
SOURCE_DATE_EPOCH ?= "1609459200"

# GStreamer 1.26.0.imx for i.MX hardware acceleration
PREFERRED_VERSION_gstreamer1.0 = "1.26.0.imx"
PREFERRED_VERSION_gstreamer1.0-plugins-base = "1.26.0.imx"
PREFERRED_VERSION_gstreamer1.0-plugins-good = "1.26.0.imx"
PREFERRED_VERSION_gstreamer1.0-plugins-bad = "1.26.0.imx"
PREFERRED_VERSION_gstreamer1.0-plugins-ugly = "1.26.0"

# Meson 1.4.2 for GStreamer 1.26.0 compatibility (requires Meson >= 1.4)
PREFERRED_VERSION_meson = "1.4.2"
```

## conf/distro/lmp-dynamicdevices-headless.conf
```bitbake
#
# Headless distribution for battery-powered and non-GUI devices
# Based on lmp-dynamicdevices.conf but optimized for devices without displays
# or interactive user interfaces (E-Ink, sensors, IoT devices, etc.)
#

require conf/distro/lmp.conf

DISTRO = "lmp-dynamicdevices-headless"
DISTROOVERRIDES = "lmp:lmp-dynamicdevices:lmp-dynamicdevices-headless"
DISTRO_NAME = "Linux-microPlatform Dynamic Devices Headless"

# Don't allow zeroconf (avahi is viewed as a security risk)
DISTRO_FEATURES:remove = " zeroconf"

# Auto register devices
DISTRO_FEATURES:append = " auto-register"

# CRA compliance audit system for EU Cyber Resilience Act
DISTRO_FEATURES:append = " cra-audit"

# === HEADLESS OPTIMIZATION ===
# Remove all GUI frameworks and graphics acceleration for headless devices
# This significantly reduces build time, complexity, and runtime resource usage
DISTRO_FEATURES:remove = " wayland opengl x11 pulseaudio alsa vulkan"

# Remove graphics-related features that consume power and resources
DISTRO_FEATURES:remove = " directfb"

# Keep essential connectivity and security features
# DISTRO_FEATURES like wifi, bluetooth, systemd, security remain enabled

# Improv protocol (BLE/Serial) onboarding for sentai unit (if needed)
DISTRO_FEATURES:append:imx8mm-jaguar-sentai = " improv"

# Improv protocol (BLE/Serial) onboarding for dt510 headless unit
DISTRO_FEATURES:append:imx8mm-jaguar-dt510 = " improv"

# Improv protocol (BLE/Serial) onboarding for eink board
DISTRO_FEATURES:append:imx93-jaguar-eink = " improv"

# Disable USB for INST board (inherited from base config)
DISTRO_FEATURES:remove:imx8mm-jaguar-inst = " usbhost usbgadget"

# Support commercial license as we need it for some audio testing
LICENSE_FLAGS_ACCEPTED:append = " commercial"

# Encrypt root directory for E-Ink board - critical for production security
# DISABLED: LUKS encryption not working properly, needs investigation
# DISTRO_FEATURES:append:imx93-jaguar-eink = " luks"

# Enable reproducible builds by setting a fixed timestamp
# This ensures identical builds from identical source code
# Set to 2021-01-01 00:00:00 UTC (1609459200)
SOURCE_DATE_EPOCH ?= "1609459200"

# === HEADLESS DEVICE OPTIMIZATION NOTES ===
# This DISTRO is optimized for:
# - E-Ink displays (static, non-interactive)
# - Battery-powered devices (5+ year life)
# - IoT sensors and data loggers
# - Headless servers and gateways
# - Any device without interactive GUI requirements
#
# Benefits:
# - Reduced build time and complexity
# - Lower runtime memory and CPU usage
# - Improved power efficiency
# - Smaller image size
# - Faster boot times
# - Focus on connectivity and core functionality

# === U-BOOT VERSION OVERRIDE ===
# Force u-boot 2024.04 to match working Sentai factory configuration
# Working Sentai uses: u-boot-fio-imx-2024.04
# Previous failing build used: u-boot-fio_imx-2023.04
PREFERRED_VERSION_u-boot-fio = "2024.04%"
PREFERRED_VERSION_u-boot-fio-imx = "2024.04%"
```

## conf/distro/lmp-dynamicdevices.conf
```bitbake
#
# Custom distribution based on the standard LMP distribution
# This allows us to extend with extra DISTRO features we need
# which can't be added elsewhere
#

require conf/distro/lmp.conf

DISTRO = "lmp-dynamicdevices"
DISTROOVERRIDES = "lmp:lmp-dynamicdevices"
DISTRO_NAME = "Linux-microPlatform  Dynamic Devices"
#DISTRO_FEATURES_BACKFILL_CONSIDERED = "ldconfig"

# Don't allow zeroconf (avahi is viewed as a security risk)
DISTRO_FEATURES:remove = " zeroconf"

# Auto register devices
DISTRO_FEATURES:append = " auto-register"

# PulseAudio support in host for sentai unit
#DISTRO_FEATURES:append:imx8mm-jaguar-sentai = " pulseaudio"

# Improv protocol (BLE/Serial) onboarding for sentai unit
DISTRO_FEATURES:append:imx8mm-jaguar-sentai = " improv"

# USB gadget support for sentai unit (for USB audio gadget, CDC serial, etc.)
DISTRO_FEATURES:append:imx8mm-jaguar-sentai = " usbgadget"

# Improv protocol (BLE) onboarding for INST board
DISTRO_FEATURES:append:imx8mm-jaguar-inst = " improv"

# Disable USB for INST board
DISTRO_FEATURES:remove:imx8mm-jaguar-inst = " usbhost usbgadget"

# E-Ink board optimization: Remove GUI frameworks not needed for static displays
# E-Ink displays don't need interactive GUI, graphics acceleration, or windowing systems
DISTRO_FEATURES:remove:imx93-jaguar-eink = " wayland opengl x11 pulseaudio"

# Encrypt root directory for E-Ink board only - critical for production security
# DISABLED: LUKS encryption not working properly, needs investigation
# DISTRO_FEATURES:append:imx93-jaguar-eink = " luks"

# Support commercial license as we need it for Sentai audio testing with sox which needs ffmpeg
LICENSE_FLAGS_ACCEPTED:append = " commercial"

# Include machine features in pre-build configuration output
BUILDCFG_VARS += "MACHINE_FEATURES"

# GStreamer 1.26.0.imx for Conversa v2.0 support with i.MX hardware acceleration
PREFERRED_VERSION_gstreamer1.0 = "1.26.0.imx"
PREFERRED_VERSION_gstreamer1.0-plugins-base = "1.26.0.imx"
PREFERRED_VERSION_gstreamer1.0-plugins-good = "1.26.0.imx"
PREFERRED_VERSION_gstreamer1.0-plugins-bad = "1.26.0.imx"
PREFERRED_VERSION_gstreamer1.0-plugins-ugly = "1.26.0"

# Meson 1.4.2 for GStreamer 1.26.0 compatibility (requires Meson >= 1.4)
PREFERRED_VERSION_meson = "1.4.2"
```

## conf/layer.conf
```bitbake
# meta-dynamicdevices-distro — shared distro / factory image policy
# See conf/lmp-feature-dev.inc for optional dev image extras (e.g. phytool on DT510)

BBFILE_COLLECTIONS += "meta-dynamicdevices-distro"
BBFILE_PATTERN_meta-dynamicdevices-distro := "^${LAYERDIR}/recipes-"
BBFILE_PRIORITY_meta-dynamicdevices-distro = "11"
LAYERVERSION_meta-dynamicdevices-distro = "1"
LAYER_CONF_VERSION ?= "7"
LAYERDESCRIPTION_meta-dynamicdevices-distro = "Dynamic Devices distro: shared LmP image and distro includes"
LAYERMAINTAINER_meta-dynamicdevices-distro = "Dynamic Devices <info@dynamicdevices.co.uk>"

BBPATH .= ":${LAYERDIR}"
BBFILES += " \
  ${LAYERDIR}/recipes*/*/*.bb \
  ${LAYERDIR}/recipes*/*/*.bbappend \
"
LAYERDEPENDS_meta-dynamicdevices-distro = "meta-lmp-base"
LAYERSERIES_COMPAT_meta-dynamicdevices-distro = "scarthgap kirkstone"
```
